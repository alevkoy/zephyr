## CMakeLists.txt
```
# SPDX-License-Identifier: Apache-2.0

cmake_minimum_required(VERSION 3.20.0)

find_package(Zephyr REQUIRED HINTS $ENV{ZEPHYR_BASE})
project(devicetree_emul)

target_sources(app PRIVATE src/main.c src/emulator.c)
```

## prj.conf
```kconfig
CONFIG_ZTEST=y
CONFIG_ZTEST_NEW_API=y
CONFIG_EMUL=y
```

## app.overlay
```dts
/*
 * Copyright (c) 2022 The Chromium OS Authors
 *
 * SPDX-License-Identifier: Apache-2.0
 *
 * Application overlay for testing the emul.h API.
 *
 * Names in this file should be chosen in a way that won't conflict
 * with real-world devicetree nodes, to allow these tests to run on
 * (and be extended to test) real hardware.
 */

/ {
	test {
		#address-cells = <0x1>;
		#size-cells = <0x1>;

		test_gpio_0: gpio@0 {
			gpio-controller;
			#gpio-cells = <0x2>;
			compatible = "vnd,gpio-device";
			status = "okay";
			reg = <0x0 0x1000>;
			label = "TEST_GPIO_0";
		};
	};
};
```

## src/main.c
```c
/*
 * Copyright (c) 2022 Google Inc
 *
 * SPDX-License-Identifier: Apache-2.0
 */

#include <device_extern.h>
#include <zephyr/devicetree.h>
#include <zephyr/drivers/emul.h>
#include <ztest.h>
#include <ztest_assert.h>
#include <ztest_test_new.h>

#define TEST_GPIO DT_NODELABEL(test_gpio_0)

ZTEST(emul, test_emul_dt_get)
{
	const struct emul *dev_emul = emul_get_binding(DT_LABEL(TEST_GPIO));
	/* This variable is static to verify that the result of EMUL_DT_GET is a
	 * compile-time constant.
	 */
	static const struct emul *emul_static = EMUL_DT_GET(TEST_GPIO);

	zassert_not_null(dev_emul, "emul_get_binding returned NULL");
	zassert_equal(emul_static, dev_emul,
		      "EMUL_DT_GET returned %p but emul_get_binding returned %p",
		      emul_static, dev_emul);
}

ZTEST_SUITE(emul, NULL, NULL, NULL, NULL, NULL);
```

## src/emulator.c
```c
/*
 * Copyright (c) 2022 Google Inc
 *
 * SPDX-License-Identifier: Apache-2.0
 */

#define DT_DRV_COMPAT vnd_gpio_device

#include <zephyr/device.h>
#include <zephyr/drivers/emul.h>

static int emul_init(const struct emul *dev_emul, const struct device *parent)
{
	return 0;
}

/*
 * This emulator definition is deliberately in a different compilation unit than
 * test_emuL_dt_get to verify that emulators are externally accessible.
 */
#define EMUL_INIT(n) EMUL_DT_INST_DEFINE(n, emul_init, NULL, NULL)
DT_INST_FOREACH_STATUS_OKAY(EMUL_INIT)
```
